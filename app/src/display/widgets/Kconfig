## app/src/display/widgets/Kconfig
```kconfig
# Copyright (c) 2020 The ZMK Contributors
# SPDX-License-Identifier: MIT

menu "ZMK Display Widgets"

config ZMK_WIDGET_LAYER_STATUS
    bool "Widget for highest, active layer using small icons"
    depends on !ZMK_SPLIT || ZMK_SPLIT_ROLE_CENTRAL
    select LV_USE_LABEL

config ZMK_WIDGET_BATTERY_STATUS
    bool "Widget for battery charge information, using small icons"
    depends on ZMK_BATTERY_REPORTING
    select LV_USE_LABEL

if ZMK_WIDGET_BATTERY_STATUS

config ZMK_WIDGET_BATTERY_STATUS_SHOW_PERCENTAGE
    bool "Show battery level percentage in text"

endif

config ZMK_WIDGET_OUTPUT_STATUS
    bool "Widget for keyboard output status icons"
    depends on BT && (!ZMK_SPLIT_BLE || ZMK_SPLIT_ROLE_CENTRAL)
    select LV_USE_LABEL

config ZMK_WIDGET_PERIPHERAL_STATUS
    bool "Widget for split peripheral status icons"
    depends on BT && ZMK_SPLIT_BLE && !ZMK_SPLIT_ROLE_CENTRAL
    select LV_USE_LABEL

config ZMK_WIDGET_WPM_STATUS
    bool "Widget for displaying typed words per minute"
    depends on !ZMK_SPLIT || ZMK_SPLIT_ROLE_CENTRAL
    select LV_USE_LABEL
    select ZMK_WPM


config ZMK_WIDGET_DONGLE_LINK_STATUS
    bool "Widget showing 2.4G ESB link status on dongle"
    depends on ZMK_2G4_DONGLE
    select LV_USE_LABEL

config ZMK_WIDGET_BONGO_CAT
    bool "Bongo cat animation widget driven by WPM"
    depends on ZMK_WPM && ZMK_DISPLAY
    select LV_USE_CANVAS
    select LV_USE_LABEL

config ZMK_WIDGET_DONGLE_BATTERY_STATUS
    bool "Dongle battery widget showing L/R/N levels from 2.4G reports"
    depends on ZMK_2G4_DONGLE
    select LV_USE_LABEL

endmenu
```

## app/src/split/bluetooth/Kconfig
```kconfig
# Copyright (c) 2022 The ZMK Contributors
# SPDX-License-Identifier: MIT

if ZMK_SPLIT && ZMK_SPLIT_BLE

menu "BLE Transport"

config ZMK_SPLIT_BLE_PRIORITY
    int "BLE transport priority"
    help
        Lower number priorities transports are favored over higher numbers.

# Added for backwards compatibility. New shields / board should set `ZMK_SPLIT_ROLE_CENTRAL` only.
config ZMK_SPLIT_BLE_ROLE_CENTRAL
    bool
    select ZMK_SPLIT_ROLE_CENTRAL

config ZMK_SPLIT_ROLE_CENTRAL
    select BT_CENTRAL
    select BT_GATT_CLIENT
    select BT_GATT_AUTO_DISCOVER_CCC
    select BT_SCAN_WITH_IDENTITY

# Bump this value needed for concurrent GATT discovery of splits
config BT_L2CAP_TX_BUF_COUNT
    default 5 if ZMK_SPLIT_ROLE_CENTRAL

if ZMK_SPLIT_ROLE_CENTRAL

config ZMK_SPLIT_BLE_CENTRAL_PERIPHERALS
    int "Number of peripherals that will connect to the central."

menuconfig ZMK_SPLIT_BLE_CENTRAL_BATTERY_LEVEL_FETCHING
    bool "Fetch Peripheral Battery Level Info"
    help
      Adds internal support for fetching the battery levels from peripherals
      and generating events in the ZMK eventing system.

if ZMK_SPLIT_BLE_CENTRAL_BATTERY_LEVEL_FETCHING

config ZMK_SPLIT_BLE_CENTRAL_BATTERY_LEVEL_QUEUE_SIZE
    int "Max number of battery level events to queue when received from peripherals"
    default ZMK_SPLIT_BLE_CENTRAL_PERIPHERALS

config ZMK_SPLIT_BLE_CENTRAL_BATTERY_LEVEL_PROXY
    bool "Proxy Peripheral Battery Level Info"
    help
      Adds support for reporting the battery levels of connected split
      peripherals through an additional Battery Level service.

endif

config ZMK_SPLIT_BLE_CENTRAL_POSITION_QUEUE_SIZE
    int "Max number of key position state events to queue when received from peripherals"
    default 5

config ZMK_SPLIT_BLE_CENTRAL_SPLIT_RUN_STACK_SIZE
    int "BLE split central write thread stack size"
    default 512

config ZMK_SPLIT_BLE_CENTRAL_SPLIT_RUN_QUEUE_SIZE
    int "Max number of behavior run events to queue to send to the peripheral(s)"
    default 5

config ZMK_SPLIT_BLE_PREF_INT
    int "Connection interval to use for split central/peripheral connection"
    default 6

config ZMK_SPLIT_BLE_PREF_LATENCY
    int "Latency to use for split central/peripheral connection"
    default 30

config ZMK_SPLIT_BLE_PREF_TIMEOUT
    int "Supervision timeout to use for split central/peripheral connection"
    default 400

endif # ZMK_SPLIT_ROLE_CENTRAL

if !ZMK_SPLIT_ROLE_CENTRAL

config ZMK_SPLIT_BLE_PERIPHERAL_STACK_SIZE
    int "BLE split peripheral notify thread stack size"
    default 756

config ZMK_SPLIT_BLE_PERIPHERAL_PRIORITY
    int "BLE split peripheral notify thread priority"
    default 5

config ZMK_SPLIT_BLE_PERIPHERAL_POSITION_QUEUE_SIZE
    int "Max number of key position state events to queue to send to the central"
    default 10

config BT_MAX_PAIRED
    default 1

config BT_MAX_CONN
    default 1

# Allow central to specify connection parameters.
config BT_GAP_AUTO_UPDATE_CONN_PARAMS
    default n

config ZMK_SPLIT_BLE_GIVE_UP_TIMEOUT_MS
    int "Milliseconds after disconnect before BLE transport yields to fallback"
    default 1500
    help
      When the BLE link drops (or never connects) and this timer elapses the
      transport reports available=false so the selector can re-cycle it (or try
      a fallback transport, if one is built in).  Resets immediately when BLE
      reconnects.  Keep this long enough to ride out brief BLE blips without
      needlessly restarting advertising.

config ZMK_SPLIT_BLE_FAST_GIVE_UP_MS
    int "Milliseconds before yielding to fallback after an intentional disconnect"
    default 120
    help
      When the central deliberately drops the peripheral (HCI reason
      "remote user terminated", e.g. it is rebooting or disabled BLE) the link
      is almost certainly gone for good, so there is no point waiting out the
      full GIVE_UP_TIMEOUT.  This shorter timer lets the peripheral start its
      reconnect cycle almost immediately.

config ZMK_SPLIT_BLE_RETRY_TIMEOUT_MS
    int "Milliseconds between BLE retry attempts after the transport gave up"
    default 500
    help
      After giving up, the transport reports itself available again after this
      many milliseconds, which makes the selector re-enable it and restart
      advertising from scratch.  Together with the give-up timer this cycles
      the peripheral through fresh BLE advertising windows so the central gets
      repeated chances to reconnect after a drop.

endif # !ZMK_SPLIT_ROLE_CENTRAL

endmenu

endif # ZMK_SPLIT_BLE
```
